## package/reThings/Config.in
```kconfig
menuconfig BR2_PACKAGE_RETERMINAL_DM
	bool "rethings"
	select BR2_PACKAGE_HOST_DTC
	help
	  Seeed Studio reTerminal/ reTerminal DM and reComputer r100x DTS files that may be useful on Nerves systems.
```
